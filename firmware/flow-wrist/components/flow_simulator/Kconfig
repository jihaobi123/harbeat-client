## firmware/flow-wrist/components/flow_simulator/Kconfig
```kconfig
menu "Flow Wrist"
    config FLOW_SIMULATOR
        bool "Enable local Hub simulator"
        default y
        help
            Drive the UI without an RK3588 Hub. Disable for BLE integration.
endmenu
```
